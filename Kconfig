## Kconfig
```kconfig
#
# $ Copyright Open Broadcom $
#
#
# <<Broadcom-WL-IPTag/Open:>>
#

config BCMDHD
	tristate "IFX DHD wireless cards support"
	help
	  This module adds support for wireless adapters based on
	  IFX chipset.

	  If you choose to build a module, it'll be called dhd. Say M if
	  unsure.

choice
	prompt "Enable Chip Interface"
	depends on BCMDHD
	help
	  Enable Chip Interface.
config BCMDHD_SDIO
	bool "SDIO bus interface support"
	depends on BCMDHD && MMC
	select BCMDHD_SDMMC
config BCMDHD_PCIE
	bool "PCIe bus interface support"
	depends on BCMDHD && PCI
endchoice

choice
	prompt "Host Wake Method"
	depends on BCMDHD
	help
	  Select chip wakeup method.
config BCMDHD_IB_HOST_WAKE
	bool "In-band host wake"
	depends on BCMDHD
	help
	  Use the data link to wake up host.
config BCMDHD_OOB_HOST_WAKE
	bool "Out-of-band host wake"
	depends on BCMDHD && BCMDHD_SDIO
	help
	  Use the external GPIO pin to wake up host.
endchoice

config DHD_OF_SUPPORT
	bool "Use in-drive platform device"
	depends on BCMDHD
	default n

config BCMDHD_FW_PATH
	depends on BCMDHD
	string "Firmware path"
	help
	  Path to the firmware file.

config BCMDHD_NVRAM_PATH
	depends on BCMDHD
	string "NVRAM path"
	help
	  Path to the calibration file.

config BCMDHD_CLM_PATH
	depends on BCMDHD
	string "CLM path"
	help
	  Path to the clm file.

config BCMDHD_WPA3
	bool "Support WPA3 feature"
	depends on BCMDHD
	default n
	help
	  This will enable WPA3 support.

config BCMDHD_WIFI6
	bool "Support WI-Fi 6 feature"
	depends on BCMDHD
	default n
	help
	  This will enable Wi-Fi 6 support.

config BCMDHD_WIFI6_6E
	bool "Support WI-Fi 6 and Wi-Fi 6E feature"
	depends on BCMDHD && BCMDHD_WPA3
	default n
	help
	  This will enable Wi-Fi 6 and Wi-Fi 6E support.

config BROADCOM_WIFI_RESERVED_MEM
	bool "Reserved memory for wifi device"
	depends on BCMDHD
	default n
	help
	  Reserved memory for wifi device.

config DHD_USE_STATIC_BUF
	bool "Enable memory preallocation"
	depends on BCMDHD && BROADCOM_WIFI_RESERVED_MEM
	default n
	help
	  Use memory preallocated in platform.

config CYW43022
	bool "Support CYW43022 chipset"
	depends on BCMDHD
	default n

config DHD_SET_RANDOM_MAC_VAL
	hex "Vendor OUI"
	depends on BCMDHD
	default 0x001A11
	help
	  Set vendor OUI for SoftAP

config WL_AP_IF
	bool "Create additional AP interface during intialization"
	depends on BCMDHD
	default n
	help
	  Create additional AP interface during initialization.

config ENABLE_HOGSQS
	bool "Hogger Squasher"
	depends on BCMDHD
	default n

config BCMDHD_DPC_IN_ISR
	bool "Trigger DPC in ISR thread"
	depends on BCMDHD && BCMDHD_IB_HOST_WAKE
	default n
	help
	  Handle data processing inside interrupt handler.

config BCMDHD_GET_OOB_STATE
	bool "Support WLAN_HOST_WAKE pin level information"
	depends on BCMDHD && BCMDHD_OOB_HOST_WAKE
	default n
	help
	  Support WLAN_HOST_WAKE pin level information.
```
